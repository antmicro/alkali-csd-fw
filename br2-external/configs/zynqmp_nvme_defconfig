## br2-external/configs/zynqmp_nvme_defconfig
```kconfig
BR2_aarch64=y
BR2_TOOLCHAIN_BUILDROOT_GLIBC=y
BR2_DL_DIR="$(BASE_DIR)/dl"

# Linux kernel

BR2_KERNEL_HEADERS_4_19=y

BR2_LINUX_KERNEL=y
BR2_LINUX_KERNEL_CUSTOM_GIT=y
BR2_LINUX_KERNEL_CUSTOM_REPO_URL="https://github.com/Xilinx/linux-xlnx.git"
BR2_LINUX_KERNEL_CUSTOM_REPO_VERSION="9c71c6e9"
BR2_LINUX_KERNEL_VERSION="9c71c6e9"
BR2_LINUX_KERNEL_USE_DEFCONFIG=y
BR2_LINUX_KERNEL_DEFCONFIG="zynqmp_nvme"
BR2_LINUX_KERNEL_IMAGE=y
BR2_LINUX_KERNEL_GZIP=y
BR2_LINUX_KERNEL_DTS_SUPPORT=y
BR2_LINUX_KERNEL_CUSTOM_DTS_PATH="${BR2_EXTERNAL_NVME_FIRMWARE_PATH}/board/basalt/kernel/zynqmp-basalt-nvme.dts ${BR2_EXTERNAL_NVME_FIRMWARE_PATH}/board/basalt/kernel/zynqmp.dtsi ${BR2_EXTERNAL_NVME_FIRMWARE_PATH}/board/basalt/kernel/zynqmp-clk-ccf.dtsi"

# Bootloaders

BR2_SSP_NONE=y # NOTE: Required, otherwiise it is impossible to build arm-trusted-firmware

BR2_TARGET_ARM_TRUSTED_FIRMWARE=y
BR2_TARGET_ARM_TRUSTED_FIRMWARE_CUSTOM_GIT=y
BR2_TARGET_ARM_TRUSTED_FIRMWARE_VERSION="xilinx-v2019.2"
BR2_TARGET_ARM_TRUSTED_FIRMWARE_CUSTOM_REPO_URL="https://github.com/xilinx/arm-trusted-firmware"
BR2_TARGET_ARM_TRUSTED_FIRMWARE_CUSTOM_REPO_VERSION="xilinx-v2019.2"
BR2_TARGET_ARM_TRUSTED_FIRMWARE_PLATFORM="zynqmp"
BR2_TARGET_ARM_TRUSTED_FIRMWARE_BL31_UBOOT=y
BR2_TARGET_ARM_TRUSTED_FIRMWARE_ADDITIONAL_TARGETS=""
BR2_TARGET_ARM_TRUSTED_FIRMWARE_ADDITIONAL_VARIABLES=""
BR2_TARGET_ARM_TRUSTED_FIRMWARE_IMAGES="bl31/*.elf"

BR2_TARGET_GRUB2_ARCH_SUPPORTS=y
BR2_TARGET_UBOOT=y
BR2_TARGET_UBOOT_BUILD_SYSTEM_KCONFIG=y
BR2_TARGET_UBOOT_CUSTOM_GIT=y
BR2_TARGET_UBOOT_CUSTOM_REPO_URL="https://github.com/Xilinx/u-boot-xlnx"
BR2_TARGET_UBOOT_CUSTOM_REPO_VERSION="xilinx-v2019.2"
BR2_TARGET_UBOOT_VERSION="xilinx-v2019.2"
BR2_TARGET_UBOOT_PATCH=""
BR2_TARGET_UBOOT_USE_DEFCONFIG=y
BR2_TARGET_UBOOT_BOARD_DEFCONFIG="xilinx_zynqmp_zcu106_revA"
BR2_TARGET_UBOOT_CONFIG_FRAGMENT_FILES=""
BR2_TARGET_UBOOT_FORMAT_ELF=y

BR2_PACKAGE_GLIBC_UTILS=y
BR2_TOOLCHAIN_BUILDROOT_CXX=y
BR2_TOOLCHAIN_BUILDROOT_FORTRAN=y
BR2_GCC_ENABLE_LTO=y
BR2_ROOTFS_DEVICE_CREATION_DYNAMIC_MDEV=y
BR2_ROOTFS_OVERLAY="${BASE_DIR}/board/basalt/overlay/"
BR2_TARGET_ROOTFS_CPIO=y
BR2_TARGET_ROOTFS_CPIO_LZO=y
BR2_TARGET_ROOTFS_CPIO_UIMAGE=y
BR2_TARGET_ROOTFS_SQUASHFS=y
BR2_TARGET_ROOTFS_SQUASHFS4_LZO=y
BR2_PACKAGE_HOST_DOSFSTOOLS=y
BR2_PACKAGE_HOST_DTC=y
BR2_PACKAGE_HOST_E2FSPROGS=y
BR2_PACKAGE_HOST_GENIMAGE=y
BR2_PACKAGE_HOST_KMOD=y
BR2_PACKAGE_HOST_MTOOLS=y

BR2_GLOBAL_PATCH_DIR="${BR2_EXTERNAL_NVME_FIRMWARE_PATH}/board/basalt/patches/"
```
